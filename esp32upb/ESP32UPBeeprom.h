#define ESP32UPBeepromversion 7
#include <EEPROM.h>

//#include "ESP32UPBdisplay.h"

//#include <WiFi.h>


// prototypes

void dumpeeprom();
void seteepromchecksum();
uint8_t geteepromchecksum();
void reseteeprom(uint32_t device_vid_pid);

bool commitflag;

// default EEPROM registers for these device types

uint8_t eepromdataUS140T[] = {

//  00   01   02   03   04   05   06   07   08   09   0A   0B   0C   0D   0E   0F   
	0x02,0xFE,0x23,0x90,0x80,0x02,0x00,0x04,0x00,0x22,0x02,0x22,0x49,0x96,0x02,0xD2, // 00-0F
	0x4E,0x65,0x77,0x20,0x6E,0x65,0x74,0x77,0x6F,0x72,0x6B,0x20,0x20,0x20,0x20,0x20, // 10-1F
	0x4E,0x65,0x77,0x20,0x72,0x6F,0x6F,0x6D,0x20,0x20,0x20,0x20,0x20,0x20,0x20,0x20, // 20-2F
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	0xFF,0xFF,0xFF,0xFF,0xFF,0xFF,0xFF,0xFF,0xFF,0x00,0xFF,0xFF,0xFF,0xFF,0xFF,0xFF, // F0-FF
	};

uint8_t eepromdataUS2240T[] = {

//  00   01   02   03   04   05   06   07   08   09   0A   0B   0C   0D   0E   0F   
	0x02,0xFE,0xAF,0xAF,0x80,0x02,0x00,0x04,0x00,0x3E,0x01,0x20,0x49,0x96,0x02,0xD2, // 00-0F
	0x4E,0x65,0x77,0x20,0x6E,0x65,0x74,0x77,0x6F,0x72,0x6B,0x20,0x20,0x20,0x20,0x20, // 10-1F
	0x4E,0x65,0x77,0x20,0x72,0x6F,0x6F,0x6D,0x20,0x20,0x20,0x20,0x20,0x20,0x20,0x20, // 20-2F
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	0xFF,0xFF,0xFF,0xFF,0xFF,0xFF,0xFF,0xFF,0xFF,0x00,0xFF,0xFF,0xFF,0xFF,0xFF,0xFF, // F0-FF
	};


// -=-=-=-=-=-=-=-=-=-=-=-=-=-=-=-=-=-=-=-=-=-=-=-=-=-=-=-=-=-=-=-=-=-=-=-=-=-

void dumpeeprom()
{
  char tempstring[100];

  Serial.print("  //  ");
  for (uint8_t j=0; j<16; j++)
  {
    Serial.printf("%02X   ",j);
  }
  Serial.println();

  for (uint16_t i=0; i<0x200; i=i+16)
  {
    Serial.print("  ");
    for (uint8_t j=0; j<16; j++)
    {
      Serial.printf("0x%02X,",EEPROM.read(i+j));
    }

    Serial.print(" // ");
    Serial.printf("%02X-%02X\n",i,i+15);

    Serial.print("  // ");
    for (uint8_t j=0; j<16; j++)
    {
      uint8_t z=EEPROM.read(i+j);
  
      // blank out unprintable characters to period
      if (isprintable(z))
      {
        Serial.printf("%c",z);
      }
      else
      {
        Serial.print(".");
      }
      Serial.print("    ");
    }
    Serial.println();
  }
}

// -=-=-=-=-=-=-=-=-=-=-=-=-=-=-=-=-=-=-=-=-=-=-=-=-=-=-=-=-=-=-=-=-=-=-=-=-=-

// checksum the first 192 registers
// ie don't include the scratch and status registers
// and FF where the checksum is stored

void seteepromchecksum()
{
	// use first four bytes of MAC address as serial number
	for (uint8_t i=0; i<4; i++)
	{
		EEPROM.write(0x0C+i,hexcharstobyte(WiFi.macAddress()[3*i], WiFi.macAddress()[3*i+1]));
	}

	// mask high bit of first byte to ensure serial number appears positive in UPStart
	EEPROM.write(0x0C, EEPROM.read(0x0C) & 0x7F);

	
  uint8_t checksum=0;
  for (uint8_t i=0; i<0xC0; i++)
  {
    // cheating as uint8_t won't ever go over FF. we hope.
    if (i != 0xF9) {checksum+=EEPROM.read(i);}
  }

  EEPROM.write(0xFF, checksum);
	#if (DEBUG_LEVEL > 1)
	 Serial.printf("Writing checksum %02X\n",checksum);
  #endif
  commitflag=true;
}

// -=-=-=-=-=-=-=-=-=-=-=-=-=-=-=-=-=-=-=-=-=-=-=-=-=-=-=-=-=-=-=-=-=-=-=-=-=-

// checksum the first 192 registers
// ie don't include the scratch and status registers
// and FF where the checksum is stored

uint8_t geteepromchecksum()
{
  uint8_t checksum=0;
  for (uint8_t i=0; i<0xC0; i++)
  {
    // cheating as uint8_t won't ever go over FF. we hope.
    if (i != 0xF9) {checksum+=EEPROM.read(i);}
	}

  return checksum;
}

// -=-=-=-=-=-=-=-=-=-=-=-=-=-=-=-=-=-=-=-=-=-=-=-=-=-=-=-=-=-=-=-=-=-=-=-=-=-

void reseteeprom(uint32_t device_vid_pid)
{
	uint8_t eepromdata[256];
	
	switch (device_vid_pid)
	{
		case 0x00040022: // US140T
			memcpy(eepromdata,eepromdataUS140T,256);
			break;
			
		case 0x0004003e: // US2240T
			memcpy(eepromdata,eepromdataUS2240T,256);
			break;
		default:
			Serial.printf("Error: unknown device_vid_pid of %08x\n",device_vid_pid);
			return;
			break;

	}

  // byte FF is checksum of the 00-FE for validity check

	// use first four bytes of MAC address as serial number
	for (uint8_t i=0; i<4; i++)
	{
		eepromdata[0x0C+i]=hexcharstobyte(WiFi.macAddress()[3*i], WiFi.macAddress()[3*i+1]);
	}

	// mask high bit of first byte to ensure serial number appears positive in UPStart
	eepromdata[0x0C] = eepromdata[0x0C] & 0x7F;

  for (uint8_t i=0; i<0xFF; i++)
  {
    EEPROM.write(i,eepromdata[i]);
  }

  Serial.printf("Checksum %02X\n",geteepromchecksum());

  seteepromchecksum();

	EEPROM.commit();
}

// -=-=-=-=-=-=-=-=-=-=-=-=-=-=-=-=-=-=-=-=-=-=-=-=-=-=-=-=-=-=-=-=-=-=-=-=-=-
